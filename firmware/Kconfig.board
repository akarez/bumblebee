## firmware/Kconfig.board
```kconfig
# Bumblebee board configuration

# Copyright (c) 2024 The ZMK Contributors
# SPDX-License-Identifier: MIT

config BOARD_BUMBLEBEE
    bool "bumblebee"
    depends on SOC_NRF52840_QIAA
```

## firmware/Kconfig.defconfig
```kconfig
# Bumblebee board configuration

# Copyright (c) 2024 The ZMK Contributors
# SPDX-License-Identifier: MIT

if BOARD_BUMBLEBEE

config BOARD
    default "bumblebee"

if USB_DEVICE_STACK

config USB_NRFX
    default y

config USB_DEVICE_STACK
    default y

endif # USB

config BT_CTLR
    default BT

endif # BOARD_BUMBLEBEE
```
